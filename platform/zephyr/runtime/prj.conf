## CMakeLists.txt
```
cmake_minimum_required(VERSION 3.20.0)
find_package(Zephyr REQUIRED HINTS $ENV{ZEPHYR_BASE})
project(zarc_runtime_reference LANGUAGES C)
set(ZARC_ROOT ${CMAKE_CURRENT_SOURCE_DIR}/../../..)
find_package(Python3 REQUIRED COMPONENTS Interpreter)
if(NOT CONFIG_ZARC_REFERENCE_PROFILE MATCHES "^(edge|companion|zonal|integrated)$")
 message(FATAL_ERROR "Unknown reference profile")
endif()
set(MANIFEST ${ZARC_ROOT}/config/targets/native-sim-${CONFIG_ZARC_REFERENCE_PROFILE}.json)
set(GENERATED ${CMAKE_CURRENT_BINARY_DIR}/generated/zarc_manifest.h)
add_custom_command(OUTPUT ${GENERATED}
 COMMAND ${Python3_EXECUTABLE} ${ZARC_ROOT}/tools/target_manifest.py
         ${MANIFEST} --header ${GENERATED}
 DEPENDS ${ZARC_ROOT}/tools/target_manifest.py ${MANIFEST}
 VERBATIM)
add_custom_target(zarc_manifest DEPENDS ${GENERATED})
add_dependencies(app zarc_manifest)
target_include_directories(app PRIVATE ${ZARC_ROOT}/include ${CMAKE_CURRENT_BINARY_DIR}/generated)
target_include_directories(app PRIVATE ../adapters)
target_sources(app PRIVATE src/main.c src/provider_fixture.c src/observation_fixture.c src/maintenance_fixture.c
 ../adapters/observation_bus.c ../adapters/device_pm.c ../adapters/storage.c
 ${ZARC_ROOT}/src/runtime.c ${ZARC_ROOT}/src/runtime_wire.c ${ZARC_ROOT}/src/composition.c
 ${ZARC_ROOT}/src/domain.c ${ZARC_ROOT}/src/controller.c ${ZARC_ROOT}/src/connect.c
 ${ZARC_ROOT}/src/health.c ${ZARC_ROOT}/src/diagnostics.c
 ${ZARC_ROOT}/src/config_store.c ${ZARC_ROOT}/src/diag_store.c ${ZARC_ROOT}/src/update_journal.c ${ZARC_ROOT}/src/update.c
 ${ZARC_ROOT}/src/power.c ${ZARC_ROOT}/src/schedule.c ${ZARC_ROOT}/src/observations.c)

if(CONFIG_IPC_SERVICE)
 target_include_directories(app PRIVATE ../adapters)
 target_sources(app PRIVATE ../adapters/ipc.c src/ipc_fixture.c)
endif()
```

## Kconfig
```
mainmenu "ZARC continuous benign reference"
source "Kconfig.zephyr"
config ZARC_RUNTIME_SMOKE
 bool "Exit after observed reference result"
 default n

config ZARC_REFERENCE_PROFILE
 string "Simulator product profile"
 default "edge"
```

## prj.conf
```kconfig
CONFIG_MAIN_STACK_SIZE=8192
CONFIG_ASSERT=y
CONFIG_PRINTK=y
CONFIG_MAIN_THREAD_PRIORITY=1
CONFIG_ZBUS=y
CONFIG_ZBUS_PREFER_DYNAMIC_ALLOCATION=n
CONFIG_PM_DEVICE=y
CONFIG_PM_DEVICE_RUNTIME=y
CONFIG_FLASH=y
CONFIG_FLASH_MAP=y
CONFIG_FLASH_PAGE_LAYOUT=y
CONFIG_NVS=y
```

## src/main.c
```c
#include <zephyr/kernel.h>
#include <zephyr/sys/printk.h>
#include <zephyr/sys/util.h>
#include "zarc/runtime_wire.h"
#include "zarc/power.h"
#include "zarc_manifest.h"
#include "provider_fixture.h"
#include "observation_fixture.h"
#include "maintenance_fixture.h"
/* Simulator-only device readback and lab-local trusted peer. */
BUILD_ASSERT(CONFIG_MAIN_STACK_SIZE==ZARC_RUNTIME_MAIN_STACK,"manifest stack mismatch");
BUILD_ASSERT(CONFIG_MAIN_THREAD_PRIORITY==ZARC_RUNTIME_MAIN_PRIORITY,"manifest priority mismatch");
BUILD_ASSERT(ZARC_PROFILE_ENDPOINT_COUNT<=ZARC_CONTROLLER_DOMAINS,"endpoint allocation");
static zarc_runtime runtime;
static struct zarc_profile_observer observer;
static zarc_power power;
static uint64_t profile_boot_tick;
static bool ipc_opened;

struct encoded {size_t n;uint8_t data[ZARC_FRAME_HEADER+ZARC_PAYLOAD_MAX];};
K_MSGQ_DEFINE(lab_queue,sizeof(struct encoded),2,8);
#if defined(CONFIG_IPC_SERVICE)
int zarc_profile_ipc_open(void);
int zarc_profile_ipc_exchange(const zarc_frame *,zarc_frame *);
int zarc_profile_ipc_close(void);
#endif
static uint64_t ticks(void){return (uint64_t)k_uptime_get();}
static bool scope(void *ctx,uint64_t principal,uint8_t op,uint32_t id){
 ARG_UNUSED(ctx);ARG_UNUSED(op);ARG_UNUSED(id);
 return principal==1; /* fixed simulation identity only */
}
static bool wire(const zarc_frame *q,uint64_t now,zarc_frame *reply,zarc_controller_effect *effect){
 zarc_frame received;
#if defined(CONFIG_IPC_SERVICE)
 if(ZARC_PROFILE_KIND==3u){
  if(zarc_profile_ipc_exchange(q,&received)!=0)return false;
 }else
#endif
 {
  struct encoded bytes={0},copy;
  if(!zarc_frame_encode(q,bytes.data,sizeof bytes.data,&bytes.n)||
     k_msgq_put(&lab_queue,&bytes,K_NO_WAIT)!=0||k_msgq_get(&lab_queue,&copy,K_NO_WAIT)!=0||
     !zarc_frame_decode(copy.data,copy.n,&received))return false;
 }
 const zarc_wire_peer p={.principal=1,.age_known=true,.allow=scope};
 return zarc_runtime_dispatch(&runtime,&p,&received,now,true,reply,effect);
}
static bool simple_init(void *ctx){ARG_UNUSED(ctx);return true;}
static bool simple_start(void *ctx){ARG_UNUSED(ctx);return true;}
static bool simple_quiesce(void *ctx,uint64_t deadline){ARG_UNUSED(ctx);return ticks()<deadline;}
static bool simple_transition(void *ctx){ARG_UNUSED(ctx);return true;}
static void simple_release(void *ctx){ARG_UNUSED(ctx);}
static bool power_init(void *ctx){ARG_UNUSED(ctx);return zarc_power_init(&power,3,1,profile_boot_tick);}
static bool power_quiesce(void *ctx,uint64_t deadline){
 ARG_UNUSED(ctx);return ticks()<deadline&&power.phase!=ZARC_POWER_WAITING&&power.phase!=ZARC_POWER_READY;
}
static bool broker_quiesce(void *ctx,uint64_t deadline){ARG_UNUSED(ctx);return ticks()<deadline&&k_msgq_num_used_get(&lab_queue)==0;}
static void broker_release(void *ctx){ARG_UNUSED(ctx);k_msgq_purge(&lab_queue);}
static bool ipc_init(void *ctx){
 ARG_UNUSED(ctx);
#if defined(CONFIG_IPC_SERVICE)
 if(zarc_profile_ipc_open()!=0)return false;
 ipc_opened=true;return true;
#else
 return false;
#endif
}
static bool ipc_suspend(void *ctx){
 ARG_UNUSED(ctx);
#if defined(CONFIG_IPC_SERVICE)
 if(!ipc_opened||zarc_profile_ipc_close()!=0)return false;
 ipc_opened=false;return true;
#else
 return false;
#endif
}
static void ipc_release(void *ctx){
 ARG_UNUSED(ctx);
 if(ipc_opened)(void)ipc_suspend(NULL);
}
static size_t profile_services(zarc_service_descriptor *ext){
 if(ZARC_PROFILE_KIND==0u)return 0;
 ext[0]=(zarc_service_descriptor){.id=3,.required=true,.dependency_count=2,.dependencies={1,2},
  .init=simple_init,.start=simple_start,.quiesce=simple_quiesce,.suspend=simple_transition,
  .resume=simple_transition,.release=simple_release};
 if(ZARC_PROFILE_KIND==1u){
  ext[0].init=power_init;ext[0].quiesce=power_quiesce;
  ext[1]=ext[0];ext[1].id=4;ext[1].init=simple_init;ext[1].quiesce=broker_quiesce;ext[1].release=broker_release;
  return 2;
 }
 if(ZARC_PROFILE_KIND==3u){
  ext[0].init=ipc_init;ext[0].suspend=ipc_suspend;ext[0].resume=ipc_init;ext[0].release=ipc_release;
 }
 return 1;
}
static bool profile_setup(void){
 size_t expected=ZARC_PROFILE_KIND==1u?4u:ZARC_PROFILE_KIND==0u?2u:3u;
 if(ZARC_MANIFEST_SERVICE_COUNT!=expected)return false;
 for(size_t i=0;i<expected;++i)if(zarc_manifest_service_order[i]!=i+1u)return false;
 return true;
}
int main(void){
 zarc_service_descriptor extensions[2]={0};
 const size_t extension_count=profile_services(extensions);
 const zarc_runtime_config config={.extensions=extensions,.extension_count=extension_count,
  .remote_service=ZARC_PROFILE_KIND==1u?4u:ZARC_PROFILE_KIND==0u?0u:3u,
  .count=ZARC_PROFILE_ENDPOINT_COUNT,.endpoints=ZARC_PROFILE_ENDPOINTS,
  .period=ZARC_RUNTIME_PERIOD_MS,.deadline=ZARC_RUNTIME_DEADLINE_MS,.health_limit=ZARC_RUNTIME_HEALTH_LIMIT_MS,
  .max_validity=ZARC_RUNTIME_MAX_VALIDITY_MS,.config_digest=ZARC_RUNTIME_CONFIG_DIGEST,.remote_enabled=ZARC_PROFILE_KIND!=0u};
 uint64_t boot;zarc_diagnostics restored;
 if(!zarc_profile_maintenance_open(&boot,&restored))return 1;
 uint64_t now=ticks();
 profile_boot_tick=now;
 if(!profile_setup()||!zarc_runtime_init(&runtime,&config,boot,now))return 1;
 runtime.diagnostics=restored;
 if(!zarc_composition_required_ready(&runtime.composition))return 1;
 if(!zarc_profile_provider_start(config.endpoints,config.count,boot)||
    !zarc_profile_observer_barrier(&observer,&runtime.observations))return 1;
 printk("ZARC reference %s manifest %s\n",ZARC_PROFILE_NAME,ZARC_MANIFEST_SHA256);
 bool issued=false;
 for(;;){
  zarc_runtime_sample samples[ZARC_PROFILE_ENDPOINT_COUNT];
  if(!zarc_profile_provider_sample(samples,config.count))return 1;
  now=ticks();
  if(!zarc_runtime_step_batch(&runtime,now,samples,config.count)||
     !zarc_profile_observer_pump(&observer,&runtime.observations))return 1;
  if(ZARC_PROFILE_KIND==1u&&!zarc_power_tick(&power,now))return 1;
  if(IS_ENABLED(CONFIG_ZARC_RUNTIME_SMOKE)&&!issued&&runtime.healthy){
   if(ZARC_PROFILE_KIND==1u){
    if(!zarc_power_request(&power,1,now,now+50,true)||
       !zarc_power_report(&power,1,1,0,true,now)||!zarc_power_report(&power,1,1,1,true,now)||
       power.phase!=ZARC_POWER_READY||!zarc_power_cancel(&power,1,now,true))return 1;
   }
   zarc_frame reply,q={.operation=ZARC_OP_HELLO,.request_id=1};zarc_controller_effect effect;
   if(config.remote_enabled){
    if(!wire(&q,now,&reply,&effect)||reply.payload[0]!=ZARC_CONN_COMPLETED)return 1;
    q.boot=reply.boot;q.session=reply.session;q.request_id=2;q.operation=ZARC_OP_CAPABILITIES;
    if(!wire(&q,now,&reply,&effect)||reply.payload[0]!=ZARC_CONN_COMPLETED||reply.payload[1]!=config.count)return 1;
   }
   for(size_t i=0;i<config.count;++i){
    uint32_t id=config.endpoints[i].id;
    if(config.remote_enabled){
     q.operation=ZARC_OP_DOMAIN;q.length=9;q.request_id=3u+i;
     for(size_t k=0;k<4;++k)q.payload[k]=(uint8_t)(id>>(8u*k));
     q.payload[4]=ZARC_ON;
     for(size_t k=0;k<4;++k)q.payload[5u+k]=(uint8_t)(50u>>(8u*k));
     if(!wire(&q,now,&reply,&effect)||reply.payload[0]!=ZARC_CONN_ACCEPTED||!effect.emitted)return 1;
    }else if(zarc_runtime_local_at(&runtime,id,ZARC_ON,true,now,50,true,&effect)!=ZARC_CONN_ACCEPTED)return 1;
    bool applied=false;
    if(!zarc_profile_provider_effect(&effect,&applied)||!zarc_runtime_release(&runtime,&effect,ticks())||!applied)return 1;
    now=ticks();
   }
   zarc_runtime_disconnect(&runtime);issued=true;
   if(!zarc_profile_observer_pump(&observer,&runtime.observations))return 1;
  }
  if(IS_ENABLED(CONFIG_ZARC_RUNTIME_SMOKE)&&issued){
   bool observed=true;
   for(size_t i=0;i<config.count;++i){
    zarc_observation o;
    if(!zarc_controller_snapshot(&runtime.controller,config.endpoints[i].id,&o)||o.value!=ZARC_ON||o.quality!=ZARC_QUALITY_VALID)observed=false;
   }
   if(observed){
    if(!observer.valid||!observer.delivered)return 1;
    for(size_t i=0;i<observer.count;++i)
     if(observer.cache[i].value!=ZARC_ON||observer.cache[i].quality!=ZARC_QUALITY_VALID)return 1;
    now=ticks();
    if(!zarc_runtime_suspend(&runtime,now,now+20)||
       !zarc_profile_provider_suspend()||!zarc_profile_provider_resume())return 1;
    now=ticks();
    if(!zarc_runtime_resume(&runtime,now)||runtime.healthy||
       !zarc_profile_observer_barrier(&observer,&runtime.observations)||
       !zarc_runtime_stop(&runtime,now,now+20))return 1;
    if(ipc_opened||!zarc_profile_provider_stop()||
       !zarc_profile_maintenance_close(&runtime.diagnostics))return 1;
    printk("ZARC runtime observed benign indicator and stopped\n");return 0;
   }
  }
  k_sleep(K_MSEC(1));
 }
}
```

## src/ipc_fixture.c
```c
#include <zephyr/kernel.h>
#include <zephyr/device.h>
#include <zephyr/ipc/ipc_service_backend.h>
#include <errno.h>
#include "transport.h"
/* Deliberately simulated backend, actual native IPC service and ZARC adapter.
 * No physical inter-core memory, trust, or remote peer is asserted. */
struct fixture {const struct ipc_ept_cfg *cfg;};
static struct fixture f;
static int reg(const struct device *dev,void **token,const struct ipc_ept_cfg *cfg){
 struct fixture *state=dev->data;if(state->cfg)return -EBUSY;
 state->cfg=cfg;*token=state;cfg->cb.bound(cfg->priv);return 0;
}
static int dereg(const struct device *dev,void *token){
 struct fixture *state=dev->data;if(state!=token||!state->cfg)return -EINVAL;
 state->cfg=NULL;return 0;
}
static int send_copy(const struct device *dev,void *token,const void *data,size_t len){
 struct fixture *state=dev->data;if(state!=token||!state->cfg)return -ENOTCONN;
 state->cfg->cb.received(data,len,state->cfg->priv);return (int)len;
}
static const struct ipc_service_backend api={.register_endpoint=reg,.deregister_endpoint=dereg,.send=send_copy};
DEVICE_DEFINE(zarc_profile_ipc,"zarc_profile_ipc",NULL,NULL,&f,NULL,POST_KERNEL,
 CONFIG_KERNEL_INIT_PRIORITY_DEVICE,&api);
K_MSGQ_DEFINE(ipc_queue,sizeof(struct zarc_native_bytes),2,8);
static struct zarc_native_ipc adapter;
int zarc_profile_ipc_open(void){
 return zarc_native_ipc_open(&adapter,DEVICE_GET(zarc_profile_ipc),"profile-fixture",&ipc_queue);
}
int zarc_profile_ipc_exchange(const zarc_frame *q,zarc_frame *received){
 struct zarc_native_bytes b;
 int rc=zarc_native_ipc_send(&adapter,q);
 if(rc)return rc;
 rc=k_msgq_get(&ipc_queue,&b,K_NO_WAIT);
 if(rc)return rc;
 return zarc_frame_decode(b.data,b.len,received)?0:-EBADMSG;
}
int zarc_profile_ipc_close(void){return zarc_native_ipc_close(&adapter);}
```

## src/maintenance_fixture.c
```c
#include "maintenance_fixture.h"
#include "storage.h"
#include "zarc_manifest.h"
#include <zephyr/drivers/flash.h>
#include <zephyr/storage/flash_map.h>
#include <errno.h>
#include <string.h>
/* Per-profile keys in the simulator's dedicated NVS area. This is not a
 * secure monotonic counter: cloning or losing simulator flash can reuse IDs. */
#define BOOT_KEY ((uint16_t)(200u+2u*ZARC_PROFILE_KIND))
#define DIAG_KEY ((uint16_t)(BOOT_KEY+1u))
static struct nvs_fs fs;
static const struct flash_area *area;
static struct zarc_native_diag_store journal;
static uint64_t epoch;
static uint64_t decode(const uint8_t *p){
 uint64_t value=0;for(size_t i=0;i<8;++i)value|=(uint64_t)p[i]<<(8u*i);return value;
}
static int read_epoch(struct nvs_fs *store,uint64_t *out){
 uint8_t bytes[8];ssize_t n=nvs_read(store,BOOT_KEY,bytes,sizeof bytes);
 if(n<0)return (int)n;
 if(n!=(ssize_t)sizeof bytes||!decode(bytes))return -EBADMSG;
 *out=decode(bytes);return 0;
}
static bool open_partition(void){
 if(flash_area_open(FIXED_PARTITION_ID(storage_partition),&area)!=0)return false;
 const struct device *dev=flash_area_get_device(area);struct flash_pages_info page;
 if(!device_is_ready(dev)||flash_get_page_info_by_offs(dev,area->fa_off,&page)!=0||
    page.size>UINT16_MAX||!page.size||area->fa_size/page.size<2)return false;
 fs=(struct nvs_fs){.offset=area->fa_off,.sector_size=(uint16_t)page.size,.sector_count=2,.flash_device=dev};
 return nvs_mount(&fs)==0;
}
bool zarc_profile_maintenance_open(uint64_t *boot,zarc_diagnostics *restored){
 if(!boot||!restored||area||!open_partition())return false;
 uint64_t previous=0;int result=read_epoch(&fs,&previous);
 if(result!=0&&result!=-ENOENT)return false;
 if(previous==UINT64_MAX)return false;
 epoch=previous+1u;
 journal=(struct zarc_native_diag_store){.fs=&fs,.key=DIAG_KEY};
 zarc_diagnostics loaded={0};
 result=zarc_native_diag_load(&journal,&loaded);
 if(result==-ENOENT)journal.writable=true;
 else if(result!=0||!previous)return false;
 for(size_t i=0;i<loaded.count;++i)if(loaded.records[i].epoch>previous)return false;
 uint8_t bytes[8];
 for(size_t i=0;i<8;++i)bytes[i]=(uint8_t)(epoch>>(8u*i));
 ssize_t written=nvs_write(&fs,BOOT_KEY,bytes,sizeof bytes);
 if(written!=(ssize_t)sizeof bytes||read_epoch(&fs,boot)!=0||*boot!=epoch)return false;
 *restored=loaded;return true;
}
bool zarc_profile_maintenance_close(const zarc_diagnostics *snapshot){
 if(!area||!snapshot||!epoch)return false;
 bool ok=zarc_native_diag_persist(&journal,snapshot)==0;
 /* Remount and verify the exact serialized journal at shutdown, independent
  * of the in-memory store. No erase or reinitialization on corruption. */
 if(ok){
  struct nvs_fs remount={.offset=fs.offset,.sector_size=fs.sector_size,.sector_count=fs.sector_count,.flash_device=fs.flash_device};
  struct zarc_native_diag_store check={.fs=&remount,.key=DIAG_KEY};
  zarc_diagnostics loaded;uint64_t boot;
  uint8_t expected[ZARC_DIAG_STORE_SIZE],actual[ZARC_DIAG_STORE_SIZE];
  ok=nvs_mount(&remount)==0&&read_epoch(&remount,&boot)==0&&boot==epoch&&
     zarc_native_diag_load(&check,&loaded)==0&&check.revision==journal.revision&&
     zarc_diag_store_encode(snapshot,journal.revision,expected,sizeof expected)&&
     zarc_diag_store_encode(&loaded,check.revision,actual,sizeof actual)&&
     memcmp(expected,actual,sizeof expected)==0;
 }
 flash_area_close(area);area=NULL;epoch=0;return ok;
}
```

## src/maintenance_fixture.h
```c
#ifndef ZARC_MAINTENANCE_FIXTURE_H
#define ZARC_MAINTENANCE_FIXTURE_H
#include "zarc/diagnostics.h"
/* Native simulator partition only. Call before starting and after stopping
 * the runtime/device worker. Never write flash in the active cycle path. */
bool zarc_profile_maintenance_open(uint64_t *boot,zarc_diagnostics *restored);
bool zarc_profile_maintenance_close(const zarc_diagnostics *snapshot);
#endif
```

## src/observation_fixture.c
```c
#include "observation_fixture.h"
#include "observation_bus.h"
static bool same(const zarc_observation *a,const zarc_observation *b){
 return a->id==b->id&&a->boot==b->boot&&a->value==b->value&&a->quality==b->quality&&
 a->generation==b->generation&&a->sample_tick==b->sample_tick&&a->source_sequence==b->source_sequence&&a->ready==b->ready;
}
bool zarc_profile_observer_barrier(struct zarc_profile_observer *o,const zarc_observation_stream *s){
 if(!o||!s||!s->valid||!s->boot||!s->count||s->count>ZARC_CONTROLLER_DOMAINS)return false;
 struct zarc_profile_observer next={.boot=s->boot,.cursor=s->sequence,.count=s->count,.delivered=o->delivered};
 for(size_t i=0;i<s->count;++i){
  uint64_t cursor;
  if(!zarc_observation_barrier(s,s->current[i].id,&next.cache[i],&cursor)||cursor!=s->sequence)return false;
 }
 zarc_native_observation_reset();next.valid=true;*o=next;return true;
}
bool zarc_profile_observer_pump(struct zarc_profile_observer *o,const zarc_observation_stream *s){
 if(!o||!s||!o->valid)return false;
 for(size_t i=0;i<=ZARC_EVENT_LIMIT;++i){
  zarc_observation_event e,received;
  zarc_event_status result=zarc_observation_next(s,o->boot,o->cursor,&e);
  if(result==ZARC_EVENT_EMPTY)return true;
  if(result!=ZARC_EVENT_AVAILABLE||o->cursor==UINT64_MAX||e.sequence!=o->cursor+1u||
     zarc_native_observation_publish(&e)!=0||zarc_native_observation_read(&received)!=0||
     received.sequence!=e.sequence||!same(&e.observation,&received.observation))break;
  size_t n=0;
  while(n<o->count&&o->cache[n].id!=received.observation.id)++n;
  if(n==o->count||received.observation.boot!=o->boot||
     received.observation.generation<o->cache[n].generation)break;
  o->cache[n]=received.observation;o->cursor=received.sequence;
  if(o->delivered!=UINT64_MAX)++o->delivered;
 }
 o->valid=false;return false;
}
```

## src/observation_fixture.h
```c
#ifndef ZARC_OBSERVATION_FIXTURE_H
#define ZARC_OBSERVATION_FIXTURE_H
#include "zarc/observations.h"
struct zarc_profile_observer {
 uint64_t boot,cursor,delivered;
 zarc_observation cache[ZARC_CONTROLLER_DOMAINS];
 size_t count;
 bool valid;
};
/* Single-owner simulator bridge: no blocking observers or hidden replay. */
bool zarc_profile_observer_barrier(struct zarc_profile_observer *,const zarc_observation_stream *);
bool zarc_profile_observer_pump(struct zarc_profile_observer *,const zarc_observation_stream *);
#endif
```

## src/provider_fixture.c
```c
#include <zephyr/kernel.h>
#include <zephyr/sys/util.h>
#include <string.h>
#include "provider_fixture.h"
#include "device_pm.h"
#include <zephyr/pm/device.h>
#include <errno.h>
#include "zarc_manifest.h"
enum command_kind { SAMPLE, EFFECT, SUSPEND, RESUME, STOP };
/* This device exists only on native_sim. No physical power rail is touched. */
static int fixture_pm_action(const struct device *dev,enum pm_device_action action){
 ARG_UNUSED(dev);
 return action==PM_DEVICE_ACTION_RESUME||action==PM_DEVICE_ACTION_SUSPEND?0:-ENOTSUP;
}
PM_DEVICE_DEFINE(zarc_runtime_virtual_pm,fixture_pm_action);
DEVICE_DEFINE(zarc_runtime_virtual_pm,"zarc_runtime_virtual_pm",NULL,
 PM_DEVICE_GET(zarc_runtime_virtual_pm),NULL,NULL,POST_KERNEL,CONFIG_KERNEL_INIT_PRIORITY_DEVICE,NULL);
struct command {enum command_kind kind;uint64_t id;zarc_controller_effect effect;};
struct reply {
 uint64_t id;bool ok,applied;
 size_t count;zarc_runtime_sample samples[ZARC_CONTROLLER_DOMAINS];
};
K_MSGQ_DEFINE(commands,sizeof(struct command),2,8);
K_MSGQ_DEFINE(replies,sizeof(struct reply),2,8);
K_THREAD_STACK_DEFINE(worker_stack,ZARC_RUNTIME_WORKER_STACK);
static struct k_thread worker;
static k_tid_t tid;
/* Setup before starting the worker; never mutate while it is running. */
static zarc_endpoint_config config[ZARC_CONTROLLER_DOMAINS];
static size_t count;
static uint64_t transaction,boot_epoch;
static bool fault;
static uint64_t ticks(void){return (uint64_t)k_uptime_get();}
static void run(void *a,void *b,void *c){
 ARG_UNUSED(a);ARG_UNUSED(b);ARG_UNUSED(c);
 zarc_value values[ZARC_CONTROLLER_DOMAINS]={0};
 uint64_t seq[ZARC_CONTROLLER_DOMAINS]={0},tokens[ZARC_CONTROLLER_DOMAINS]={0};
 for(size_t i=0;i<count;++i)values[i]=ZARC_OFF;
 struct zarc_native_pm pm={0};
 if(zarc_native_pm_open(&pm,DEVICE_GET(zarc_runtime_virtual_pm))!=0||zarc_native_pm_acquire(&pm)!=0)return;
 for(;;){
  struct command q;
  if(k_msgq_get(&commands,&q,K_FOREVER)!=0)return;
  struct reply r={.id=q.id,.ok=true};
  if(q.kind==SUSPEND){r.ok=zarc_native_pm_release(&pm)==0;}
  else if(q.kind==RESUME){r.ok=zarc_native_pm_acquire(&pm)==0;}
  else if(q.kind==STOP){r.ok=!pm.held||zarc_native_pm_release(&pm)==0;}
  else if(!pm.held){r.ok=false;}
  else if(q.kind==SAMPLE){
   r.count=count;
   uint64_t now=ticks();
   for(size_t i=0;i<count;++i){
    if(seq[i]==UINT64_MAX){r.ok=false;break;}
    r.samples[i]=(zarc_runtime_sample){config[i].id,++seq[i],now,values[i]};
   }
  }else if(q.kind==EFFECT){
   const zarc_controller_effect *e=&q.effect;size_t i=0;
   while(i<count&&config[i].id!=e->id)++i;
   if(i==count||!e->emitted||e->boot!=boot_epoch||!e->token||
      e->token<=tokens[i]||(e->desired!=ZARC_ON&&e->desired!=ZARC_OFF))r.ok=false;
   else {
    tokens[i]=e->token;
    /* Expired work is discarded. Readback is a later separate SAMPLE. */
    if(ticks()<e->deadline){values[i]=e->desired;r.applied=true;}
   }
  }else r.ok=false;
  if(k_msgq_put(&replies,&r,K_NO_WAIT)!=0)return;
  if(q.kind==STOP)return;
 }
}
static bool exchange(struct command *q,struct reply *r){
 if(!tid||fault||transaction==UINT64_MAX)return false;
 q->id=++transaction;
 if(k_msgq_put(&commands,q,K_NO_WAIT)!=0||k_msgq_get(&replies,r,K_MSEC(4))!=0||
    r->id!=q->id||!r->ok){fault=true;return false;}
 return true;
}
bool zarc_profile_provider_start(const zarc_endpoint_config *p,size_t n,uint64_t boot){
 if(tid||!p||!n||n>ZARC_CONTROLLER_DOMAINS||!boot)return false;
 memcpy(config,p,n*sizeof *p);count=n;transaction=0;boot_epoch=boot;fault=false;
 k_msgq_purge(&commands);k_msgq_purge(&replies);
 tid=k_thread_create(&worker,worker_stack,K_THREAD_STACK_SIZEOF(worker_stack),run,NULL,NULL,NULL,
   K_PRIO_PREEMPT(ZARC_RUNTIME_WORKER_PRIORITY),0,K_NO_WAIT);
 return tid!=NULL;
}
bool zarc_profile_provider_sample(zarc_runtime_sample *out,size_t n){
 struct command q={.kind=SAMPLE};struct reply r;
 if(!out||n!=count||!exchange(&q,&r)||r.count!=n)return false;
 memcpy(out,r.samples,n*sizeof *out);return true;
}
bool zarc_profile_provider_effect(const zarc_controller_effect *e,bool *applied){
 if(!e||!applied)return false;
 struct command q={.kind=EFFECT,.effect=*e};struct reply r;
 if(!exchange(&q,&r))return false;
 *applied=r.applied;return true;
}
bool zarc_profile_provider_suspend(void){
 struct command q={.kind=SUSPEND};struct reply r;return exchange(&q,&r);
}
bool zarc_profile_provider_resume(void){
 struct command q={.kind=RESUME};struct reply r;return exchange(&q,&r);
}
bool zarc_profile_provider_stop(void){
 if(!tid)return false;
 struct command q={.kind=STOP};struct reply r;
 bool ok=exchange(&q,&r);
 if(!ok||k_thread_join(tid,K_MSEC(100))!=0){k_thread_abort(tid);ok=false;}
 tid=NULL;return ok;
}
```

## src/provider_fixture.h
```c
#ifndef ZARC_PROFILE_PROVIDER_FIXTURE_H
#define ZARC_PROFILE_PROVIDER_FIXTURE_H
#include "zarc/runtime.h"
/* Independent simulated provider owner. Native queues copy immutable commands.
 * No physical hardware is operated. These are bounded laboratory calls, not
 * a qualified execution-time or scheduling allocation. */
bool zarc_profile_provider_start(const zarc_endpoint_config *,size_t count,uint64_t boot);
bool zarc_profile_provider_sample(zarc_runtime_sample *,size_t count);
bool zarc_profile_provider_effect(const zarc_controller_effect *,bool *applied);
bool zarc_profile_provider_suspend(void);
bool zarc_profile_provider_resume(void);
bool zarc_profile_provider_stop(void);
#endif
```
