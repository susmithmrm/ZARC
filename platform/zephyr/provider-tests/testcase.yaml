## platform/zephyr/provider-tests/testcase.yaml
```yaml
tests:
  zarc.native.providers:
    platform_allow:
      - native_sim/native/64
    integration_platforms:
      - native_sim/native/64
    tags:
      - zarc
      - drivers
      - storage
  zarc.native.mcuboot_compile:
    platform_allow:
      - native_sim/native/64
    integration_platforms:
      - native_sim/native/64
    build_only: true
    extra_configs:
      - CONFIG_STREAM_FLASH=y
      - CONFIG_IMG_MANAGER=y
    tags:
      - zarc
      - update
```

## platform/zephyr/runtime/testcase.yaml
```yaml
tests:
  zarc.native.runtime:
    platform_allow:
      - native_sim/native/64
    integration_platforms:
      - native_sim/native/64
    harness: console
    harness_config:
      type: one_line
      regex:
        - "ZARC runtime observed benign indicator and stopped"
    extra_configs:
      - CONFIG_ZARC_RUNTIME_SMOKE=y
    tags:
      - zarc
      - runtime
  zarc.native.runtime.companion:
    platform_allow:
      - native_sim/native/64
    integration_platforms:
      - native_sim/native/64
    harness: console
    harness_config:
      type: one_line
      regex:
        - "ZARC runtime observed benign indicator and stopped"
    extra_configs:
      - CONFIG_ZARC_RUNTIME_SMOKE=y
      - CONFIG_ZARC_REFERENCE_PROFILE="companion"
    tags:
      - zarc
      - runtime
  zarc.native.runtime.zonal:
    platform_allow:
      - native_sim/native/64
    integration_platforms:
      - native_sim/native/64
    harness: console
    harness_config:
      type: one_line
      regex:
        - "ZARC runtime observed benign indicator and stopped"
    extra_configs:
      - CONFIG_ZARC_RUNTIME_SMOKE=y
      - CONFIG_ZARC_REFERENCE_PROFILE="zonal"
    tags:
      - zarc
      - runtime
  zarc.native.runtime.integrated:
    platform_allow:
      - native_sim/native/64
    integration_platforms:
      - native_sim/native/64
    harness: console
    harness_config:
      type: one_line
      regex:
        - "ZARC runtime observed benign indicator and stopped"
    extra_configs:
      - CONFIG_ZARC_RUNTIME_SMOKE=y
      - CONFIG_ZARC_REFERENCE_PROFILE="integrated"
      - CONFIG_IPC_SERVICE=y
    tags:
      - zarc
      - runtime
```

## platform/zephyr/testcase.yaml
```yaml
tests:
  zarc.native_lab:
    platform_allow:
      - native_sim/native/64
    integration_platforms:
      - native_sim/native/64
    tags:
      - zarc
      - kernel
```
